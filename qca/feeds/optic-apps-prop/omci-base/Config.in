## qca/feeds/optic-apps-prop/omci-base/Config.in
```kconfig
config OMCI_BM_ENABLE
	bool "enable MAC Signature check"
	depends on PACKAGE_omci
	default n
```

## targets/ipq95xx/image/update_script.its
```
/dts-v1/;

/ {
	description = "FIT Image containing the upgrade script";

	images {
		update-script {
			description = "Update script";
			data = /incbin/("update_script.txt");
			type = "script";
			arch = "arm64";
			os = "u-boot";
			compression = "none";
		};
	};
};
```
